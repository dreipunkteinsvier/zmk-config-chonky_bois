## config/boards/shields/chonkybois/Kconfig.defconfig
```kconfig
# Copyright (c) 2023 The ZMK Contributors
# SPDX-License-Identifier: MIT

if SHIELD_CHONKYBOIS_LEFT

config ZMK_KEYBOARD_NAME
    default "Chonky Bois"
    
config ZMK_SPLIT_ROLE_CENTRAL
    default y

endif

if SHIELD_CHONKYBOIS_LEFT || SHIELD_CHONKYBOIS_RIGHT

config ZMK_SPLIT
    default y

endif
```

## config/boards/shields/chonkybois/Kconfig.shield
```kconfig
# Copyright (c) 2023 The ZMK Contributors
# SPDX-License-Identifier: MIT

config SHIELD_CHONKYBOIS_LEFT
    def_bool $(shields_list_contains,chonkybois_left)

config SHIELD_CHONKYBOIS_RIGHT
    def_bool $(shields_list_contains,chonkybois_right)
```
